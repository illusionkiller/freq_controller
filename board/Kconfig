## board/Kconfig
```kconfig
menu "Hardware Drivers Config"

menu "Onboard Peripheral Drivers"
        
    config BSP_USING_COM1
        bool "Enable COM1(485)"
        select BSP_USING_UART
        select BSP_USING_UART7
        default n

    config BSP_USING_COM2
        bool "Enable COM2(485)"
        select BSP_USING_UART
        select BSP_USING_UART8
        default n

    config BSP_USING_COM3
        bool "Enable COM3(485)"
        select BSP_USING_UART
        select BSP_USING_UART3
        default n 

    config BSP_USING_COM4
        bool "Enable COM4(485)"
        select BSP_USING_UART
        select BSP_USING_UART2
        default n           

    config BSP_USING_QSPI_FLASH
        bool "Enable QSPI FLASH (W25Q128 qspi)"
        select BSP_USING_QSPI
        select RT_USING_SFUD
        select RT_SFUD_USING_QSPI
        default n

    config BSP_USING_CAN
        bool "Enable On Board CAN"
        select RT_USING_CAN
        default n
        if BSP_USING_CAN
            config BSP_USING_CAN1
            bool "Enable On Board CAN1"
            default n
        endif    
    
    config BSP_USING_FS
        bool "Enable File System"
        select RT_USING_DFS
        select RT_USING_DFS_ROMFS
        select RT_USING_DFS_ROMFS_USER_ROOT
        default n

        if BSP_USING_FS
            config BSP_USING_SPI_FLASH_LITTLEFS
                bool "Enable SPI-FLASH (LittleFS)"
                select RT_USING_MTD_NOR
                select PKG_USING_LITTLEFS
                select BSP_USING_FAL
                default n
        endif
    
    config BSP_USING_FAL
        bool "Enable FAL (enable on-chip flash and spi flash)"
        select BSP_USING_QSPI_FLASH
        select RT_USING_FAL
        select FAL_DEBUG_CONFIG
        select FAL_PART_HAS_TABLE_CFG
        select FAL_USING_SFUD_PORT
        select BSP_USING_ON_CHIP_FLASH

    menuconfig BSP_USING_ETH
        bool "Enable Ethernet"
        default n
        select RT_USING_LWIP
        if BSP_USING_ETH
            config ETH_RESET_PIN
                string "ETH RESET PIN"
                default "PC.0"
        endif
        if BSP_USING_ETH
            choice
                prompt "Choose ETH PHY"
                default PHY_USING_LAN8720A
                        config PHY_USING_LAN8720A
                    bool "USING LAN8720A"
                    default n
            endchoice
        endif
endmenu

menu "On-chip Peripheral Drivers"
    config BSP_SCB_ENABLE_I_CACHE
        bool "Enable ICACHE"
        default y

    config BSP_SCB_ENABLE_D_CACHE
        bool "Enable DCACHE"
        default y

    config BSP_USING_GPIO
        bool "Enable GPIO"
        select RT_USING_PIN
        default y

    config BSP_USING_UART
        bool "Enable UART"
        default y
        select RT_USING_SERIAL
        select RT_USING_SERIAL_V2
        if BSP_USING_UART
            menuconfig BSP_USING_UART1
                bool "Enable UART1 (console)"
                default y
                if BSP_USING_UART1
                    config BSP_UART1_RX_USING_DMA
                        bool "Enable UART1 RX DMA"
                        depends on BSP_USING_UART1 && RT_SERIAL_USING_DMA
                        default n

                    config BSP_UART1_TX_USING_DMA
                        bool "Enable UART1 TX DMA"
                        depends on BSP_USING_UART1 && RT_SERIAL_USING_DMA
                        default n

                    config BSP_UART1_RX_BUFSIZE
                        int "Set UART1 RX buffer size"
                        range 64 65535
                        depends on RT_USING_SERIAL_V2
                        default 256

                    config BSP_UART1_TX_BUFSIZE
                        int "Set UART1 TX buffer size"
                        range 0 65535
                        depends on RT_USING_SERIAL_V2
                        default 256   

                    config BSP_UART1_DMA_PING_BUFSIZE
                        int "Set UART1 RX DMA ping-pong buffer size"
                        range 32 65535
                        depends on RT_USING_SERIAL_V2 && BSP_UART1_RX_USING_DMA
                        default 64                       
                endif

            menuconfig BSP_USING_UART2
                bool "Enable UART2"
                default n
                if BSP_USING_UART2
                    config BSP_UART2_RX_USING_DMA
                        bool "Enable UART2 RX DMA"
                        depends on BSP_USING_UART2 && RT_SERIAL_USING_DMA
                        default n

                    config BSP_UART2_TX_USING_DMA
                        bool "Enable UART2 TX DMA"
                        depends on BSP_USING_UART2 && RT_SERIAL_USING_DMA
                        default n

                    config BSP_UART2_RX_BUFSIZE
                        int "Set UART2 RX buffer size"
                        range 64 65535
                        depends on RT_USING_SERIAL_V2
                        default 256

                    config BSP_UART2_TX_BUFSIZE
                        int "Set UART2 TX buffer size"
                        range 0 65535
                        depends on RT_USING_SERIAL_V2
                        default 256

                    config BSP_UART2_DMA_PING_BUFSIZE
                        int "Set UART2 RX DMA ping-pong buffer size"
                        range 32 65535
                        depends on RT_USING_SERIAL_V2 && BSP_UART2_RX_USING_DMA
                        default 64                        
                endif

            menuconfig BSP_USING_UART3
                bool "Enable UART3"
                default n
                if BSP_USING_UART3
                    config BSP_UART3_RX_USING_DMA
                        bool "Enable UART3 RX DMA"
                        depends on BSP_USING_UART3 && RT_SERIAL_USING_DMA
                        default n

                    config BSP_UART3_TX_USING_DMA
                        bool "Enable UART3 TX DMA"
                        depends on BSP_USING_UART3 && RT_SERIAL_USING_DMA
                        default n

                    config BSP_UART3_RX_BUFSIZE
                        int "Set UART3 RX buffer size"
                        range 64 65535
                        depends on RT_USING_SERIAL_V2
                        default 256

                    config BSP_UART3_TX_BUFSIZE
                        int "Set UART3 TX buffer size"
                        range 0 65535
                        depends on RT_USING_SERIAL_V2
                        default 256

                    config BSP_UART3_DMA_PING_BUFSIZE
                        int "Set UART3 RX DMA ping-pong buffer size"
                        range 32 65535
                        depends on RT_USING_SERIAL_V2 && BSP_UART3_RX_USING_DMA
                        default 64
                endif

            menuconfig BSP_USING_UART7
                bool "Enable UART7"
                default n
                if BSP_USING_UART7
                    config BSP_UART7_RX_USING_DMA
                        bool "Enable UART7 RX DMA"
                        depends on BSP_USING_UART7 && RT_SERIAL_USING_DMA
                        default n

                    config BSP_UART7_TX_USING_DMA
                        bool "Enable UART7 TX DMA"
                        depends on BSP_USING_UART7 && RT_SERIAL_USING_DMA
                        default n

                    config BSP_UART7_RX_BUFSIZE
                        int "Set UART7 RX buffer size"
                        range 64 65535
                        depends on RT_USING_SERIAL_V2
                        default 256

                    config BSP_UART7_TX_BUFSIZE
                        int "Set UART7 TX buffer size"
                        range 0 65535
                        depends on RT_USING_SERIAL_V2
                        default 256

                    config BSP_UART7_DMA_PING_BUFSIZE
                        int "Set UART7 RX DMA ping-pong buffer size"
                        range 32 65535
                        depends on RT_USING_SERIAL_V2 && BSP_UART7_RX_USING_DMA
                        default 64
                endif

            menuconfig BSP_USING_UART8
                bool "Enable UART8"
                default n
                if BSP_USING_UART8
                    config BSP_UART8_RX_USING_DMA
                        bool "Enable UART8 RX DMA"
                        depends on BSP_USING_UART8 && RT_SERIAL_USING_DMA
                        default n

                    config BSP_UART8_TX_USING_DMA
                        bool "Enable UART8 TX DMA"
                        depends on BSP_USING_UART8 && RT_SERIAL_USING_DMA
                        default n

                    config BSP_UART8_RX_BUFSIZE
                        int "Set UART8 RX buffer size"
                        range 64 65535
                        depends on RT_USING_SERIAL_V2
                        default 256

                    config BSP_UART8_TX_BUFSIZE
                        int "Set UART8 TX buffer size"
                        range 0 65535
                        depends on RT_USING_SERIAL_V2
                        default 256

                    config BSP_UART8_DMA_PING_BUFSIZE
                        int "Set UART8 RX DMA ping-pong buffer size"
                        range 32 65535
                        depends on RT_USING_SERIAL_V2 && BSP_UART8_RX_USING_DMA
                        default 64
                endif
            
        endif

    config BSP_USING_SPI
        bool "Enable SPI BUS"
        default n
        select RT_USING_SPI
        if BSP_USING_SPI
            config BSP_USING_SPI2
                bool "Enable SPI2 BUS"
                default n
        endif

    config BSP_USING_QSPI
        bool "Enable QSPI BUS"
        select RT_USING_QSPI
        select RT_USING_SPI
        default n
        if BSP_USING_QSPI
            config BSP_QSPI_USING_DMA
                bool "Enable QSPI DMA support"
                default n
            config BSP_QSPI_USING_SOFT_CS
                bool "Enable QSPI Soft CS Pin"
                default n
        endif

    config BSP_USING_I2C
        bool "Enable I2C BUS (software simulation)"
        select RT_USING_I2C
        select RT_USING_I2C_BITOPS
        select RT_USING_PIN
        default n
        if BSP_USING_I2C
            menuconfig BSP_USING_I2C1
                bool "Enable I2C1 BUS (software simulation)"
                default n
                if BSP_USING_I2C1
                    comment "Notice: PH4 --> 116; PH5 --> 117"
                    config BSP_I2C1_SCL_PIN
                        int "i2c1 scl pin number"
                        range 1 176
                        default 8
                    config BSP_I2C1_SDA_PIN
                        int "I2C1 sda pin number"
                        range 1 176
                        default 41
                endif
    endif

    config BSP_USING_ON_CHIP_FLASH
        bool "Enable on-chip FLASH"
        default n

    menuconfig BSP_USING_ONCHIP_RTC
        bool "Enable ONCHIP RTC"
        select RT_USING_RTC
        default n
        if BSP_USING_ONCHIP_RTC
            choice
                prompt "Select clock source"
                default BSP_RTC_USING_LSE

                config BSP_RTC_USING_LSE
                    bool "RTC USING LSE"

                config BSP_RTC_USING_LSI
                    bool "RTC USING LSI"
            endchoice
        endif

    menuconfig BSP_USING_ADC
        bool "Enable ADC"
        default n
        select RT_USING_ADC
        if BSP_USING_ADC
            config BSP_USING_ADC1
                bool "Enable ADC1"
                default n
        endif

    menuconfig BSP_USING_DAC
        bool "Enable DAC"
        default n
        select RT_USING_DAC
        if BSP_USING_DAC
            config BSP_USING_DAC1
                bool "Enable DAC1"
                default n
        endif

    config BSP_USING_WDT
        bool "Enable Watchdog Timer"
        select RT_USING_WDT
        default n


    source "$(BSP_DIR)/libraries/HAL_Drivers/drivers/Kconfig"

endmenu

menu "Board extended module Drivers"

endmenu

endmenu
```
